/* SPDX-License-Identifier: Apache-2.0 */
#include "channels.dtsi"

&timers2 {
	status = "okay";
	/* APB1 timer clock = 96 MHz; prescaler register = 96 - 1. */
	st,prescaler = <95>;
	counter2: counter {
		compatible = "st,stm32-counter";
		status = "okay";
	};
};
