## app/Kconfig
```kconfig
# SPDX-License-Identifier: Apache-2.0
rsource "../deps/cannectivity/app/Kconfig"
```

## boards/comma/panda_black/board.yml
```yaml
board:
  name: panda_black
  full_name: Black Panda
  vendor: comma
  socs:
    - name: stm32f413xx
```

## boards/comma/panda_red/Kconfig.panda_red
```kconfig
# SPDX-License-Identifier: Apache-2.0

config BOARD_PANDA_RED
	select SOC_STM32H725XX
```

## boards/comma/panda_red/board.yml
```yaml
board:
  name: panda_red
  full_name: Red Panda
  vendor: comma
  socs:
    - name: stm32h725xx
```

## boards/comma/panda_red/panda_red_defconfig
```kconfig
CONFIG_GPIO=y
CONFIG_GPIO_HOGS=y
CONFIG_ADC=y
CONFIG_PINCTRL_DYNAMIC=y
CONFIG_REBOOT=y
```

## boards/comma/panda_white/Kconfig.panda_white
```kconfig
# SPDX-License-Identifier: Apache-2.0

config BOARD_PANDA_WHITE
	select SOC_STM32F413XX
```

## boards/comma/panda_white/board.yml
```yaml
board:
  name: panda_white
  full_name: White Panda
  vendor: comma
  socs:
    - name: stm32f413xx
```

## dts/bindings/comma,panda-can2-phy.yaml
```yaml
# SPDX-License-Identifier: Apache-2.0
description: Panda CAN2 transceiver pair selected by harness orientation
compatible: "comma,panda-can2-phy"
include: can-transceiver.yaml
properties:
  normal-standby-gpios:
    type: phandle-array
    required: true
  flipped-standby-gpios:
    type: phandle-array
    required: true
```

## dts/bindings/comma,panda-harness.yaml
```yaml
# SPDX-License-Identifier: Apache-2.0
description: Panda reversible harness orientation detection and alternate CAN2 pins
compatible: "comma,panda-harness"
include: [base.yaml, pinctrl-device.yaml]
properties:
  sbu-gpios:
    type: phandle-array
    required: true
    description: SBU1 and SBU2 voltage sense pins, in that order
  io-channels:
    type: phandle-array
    required: true
    description: ADC inputs for SBU1 and SBU2, in that order
  relay-gpios:
    type: phandle-array
    required: true
    description: Open-drain SBU1 and SBU2 relay controls; high releases both relays
  can-controller:
    type: phandle
    required: true
    description: CAN2 controller whose default pins change with harness orientation
```

## manifest/west.yml
```yaml
manifest:
  version: "1.2"
  projects:
    - name: cannectivity
      url: https://github.com/CANnectivity/cannectivity
      revision: 5719a5499751b77483eef7ce54512079d6ba91b1 # v1.5.0-dev
      path: deps/cannectivity
    - name: zephyr
      url: https://github.com/zephyrproject-rtos/zephyr
      revision: bf6e3a1a047822ebddde70d2a53950d8b8e1c8d1 # v4.5.0-rc3 (main)
      # The import's path-prefix applies to this project as well as its modules.
      path: zephyr
      import:
        path-prefix: deps
        name-allowlist:
          - cmsis_6
          - hal_stm32
  self:
    path: manifest
```
